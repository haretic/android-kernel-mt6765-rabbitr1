## drivers/staging/mtk-ged/Kconfig
```kconfig
# SPDX-License-Identifier: GPL-2.0
config MTK_GED_COMPAT
	tristate "MediaTek GED /proc/ged bridge for vendor graphics blobs"
	depends on PROC_FS && DMA_SHARED_BUFFER
	help
	  Provides /proc/ged with the bridge ioctl ABI of the MediaTek GED
	  driver from the MT6765 Linux 4.19 vendor kernel, as used by the
	  stock libged.so and libgralloc_extra.so. The gralloc_extra (GE)
	  metadata objects and dma-buf naming are implemented; GPU DVFS,
	  KPI and frame-rate hints are accepted without a backend.

	  If unsure, say N.
```

## drivers/staging/mtk-ion-compat/Kconfig
```kconfig
# SPDX-License-Identifier: GPL-2.0
config MTK_ION_COMPAT
	tristate "Legacy MediaTek ION ABI on top of DMA-BUF"
	depends on DMA_SHARED_BUFFER && DMABUF_HEAPS && MMU
	help
	  Provides /dev/ion with the handle-based ION ioctl ABI of the
	  MediaTek Linux 4.19 vendor kernels, including the MediaTek
	  ION_IOC_CUSTOM commands, so that unmodified MediaTek Android
	  vendor blobs (gralloc, libion_mtk, libgralloc_extra) can allocate
	  and share buffers. Every heap is served from ordinary system pages
	  exported as standard dma-bufs, which any mainline driver can
	  import. Secure heaps are not secure. Buffers tagged for an M4U port
	  whose driver registered with this device get their IOMMU address
	  from ION_SYS_GET_PHYS and ION_MM_GET_IOVA, as on stock. The
	  mtk_mm and mtk_mm-uncached DMA heaps MediaTek's Codec2 store asks
	  for serve the same buffers.

	  If unsure, say N.
```

## drivers/staging/mtk-vcodec-compat/Kconfig
```kconfig
# SPDX-License-Identifier: GPL-2.0
config MTK_VCODEC_COMPAT
	tristate "MediaTek MT6765 /dev/Vcodec for the stock video codec blobs"
	depends on ARCH_MEDIATEK || COMPILE_TEST
	depends on MTK_ION_COMPAT
	depends on MFD_SYSCON
	help
	  Provides /dev/Vcodec with the ioctl ABI of the MT6765 Linux 4.19
	  vendor kernel's video codec driver, for the stock MediaTek codec
	  libraries (libvcodecdrv and the codec2 components built on it).
	  Those libraries program the H.264 encoder and the H.264/HEVC
	  decoder themselves; this driver arbitrates, powers and routes the
	  shared codec core, delivers its interrupts and gives the libraries
	  M4U addresses for their buffers through the ION compatibility
	  device.

	  If unsure, say N.
```
