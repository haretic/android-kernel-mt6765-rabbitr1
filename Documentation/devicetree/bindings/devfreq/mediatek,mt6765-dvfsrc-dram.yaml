## Documentation/devicetree/bindings/devfreq/mediatek,mt6765-dvfsrc-dram.yaml
```yaml
# SPDX-License-Identifier: (GPL-2.0-only OR BSD-2-Clause)
%YAML 1.2
---
$id: http://devicetree.org/schemas/devfreq/mediatek,mt6765-dvfsrc-dram.yaml#
$schema: http://devicetree.org/meta-schemas/core.yaml#

title: MediaTek DVFSRC DRAM frequency

maintainers:
  - itskenny0 <anthropic@kenny.cat>

description:
  DRAM levels requested from the DVFSRC. A child of the DVFSRC node; each OPP
  is a DVFSRC level given by opp-level.

properties:
  compatible:
    const: mediatek,mt6765-dvfsrc-dram

  operating-points-v2: true

required:
  - compatible
  - operating-points-v2

additionalProperties: false
```

## Documentation/devicetree/bindings/iio/imu/invensense,icm42607.yaml
```yaml
# SPDX-License-Identifier: (GPL-2.0-only OR BSD-2-Clause)
%YAML 1.2
---
$id: http://devicetree.org/schemas/iio/imu/invensense,icm42607.yaml#
$schema: http://devicetree.org/meta-schemas/core.yaml#

title: InvenSense ICM-42607 and ICM-42670 Inertial Measurement Units

maintainers:
  - Kenny <0@kenny.cat>

description: |
  6-axis MotionTracking devices combining a 3-axis gyroscope and a 3-axis
  accelerometer, with a 2.25 kB FIFO, two interrupt pins, the APEX motion
  engine and an I3C, I2C or SPI host interface. Their register map differs
  from the ICM-426xx parts described in invensense,icm42600.yaml.

properties:
  compatible:
    enum:
      - invensense,icm42607p
      - invensense,icm42670p

  reg:
    maxItems: 1

  interrupts:
    minItems: 1
    maxItems: 2

  interrupt-names:
    minItems: 1
    maxItems: 2
    items:
      enum:
        - INT1
        - INT2

  mount-matrix:
    description: an optional 3x3 mounting rotation matrix.

  vdd-supply:
    description: Regulator that provides power to the sensor

  vddio-supply:
    description: Regulator that provides power to the bus

  spi-cpha: true
  spi-cpol: true

required:
  - compatible
  - reg

allOf:
  - $ref: /schemas/spi/spi-peripheral-props.yaml#

unevaluatedProperties: false

examples:
  - |
    spi {
        #address-cells = <1>;
        #size-cells = <0>;

        imu@0 {
            compatible = "invensense,icm42607p";
            reg = <0>;
            spi-max-frequency = <10000000>;
        };
    };
```

## Documentation/devicetree/bindings/input/ocs,och1970.yaml
```yaml
# SPDX-License-Identifier: (GPL-2.0-only OR BSD-2-Clause)
%YAML 1.2
---
$id: http://devicetree.org/schemas/input/ocs,och1970.yaml#
$schema: http://devicetree.org/meta-schemas/core.yaml#

title: Orient Chip OCH1970 Hall sensor scroll wheel

maintainers:
  - Kenny <0@kenny.cat>

description:
  3D Hall-effect sensor on I2C placed next to a magnetised wheel. The wheel
  angle follows the field in the sensor's X/Z plane and is reported as
  KEY_UP and KEY_DOWN steps.

properties:
  compatible:
    const: ocs,och1970

  reg:
    maxItems: 1

  reset-gpios:
    maxItems: 1

  vdd-supply: true

required:
  - compatible
  - reg

additionalProperties: false

examples:
  - |
    #include <dt-bindings/gpio/gpio.h>

    i2c {
        #address-cells = <1>;
        #size-cells = <0>;

        wheel@d {
            compatible = "ocs,och1970";
            reg = <0x0d>;
            reset-gpios = <&pio 173 GPIO_ACTIVE_LOW>;
        };
    };
```

## Documentation/devicetree/bindings/misc/relmon,ms35774.yaml
```yaml
# SPDX-License-Identifier: (GPL-2.0-only OR BSD-2-Clause)
%YAML 1.2
---
$id: http://devicetree.org/schemas/misc/relmon,ms35774.yaml#
$schema: http://devicetree.org/meta-schemas/core.yaml#

title: Relmon MS35774 stepper motor driver

maintainers:
  - itskenny0 <0@kenny.cat>

description:
  The MS35774 is a bipolar stepper motor driver with a STEP/DIR interface,
  an active low enable input and two microstep selection inputs. It is used
  to rotate a part over a limited range ending in a mechanical stop.

properties:
  compatible:
    const: relmon,ms35774

  vm-supply:
    description: Motor power supply, only enabled while moving.

  enable-gpios:
    maxItems: 1
    description: ENN input. Usually flagged GPIO_ACTIVE_LOW.

  dir-gpios:
    maxItems: 1
    description: DIR input. Asserted to move towards larger angles.

  step-gpios:
    maxItems: 1
    description: STEP input. Must not be on a sleeping GPIO controller.

  powerdown-gpios:
    maxItems: 1
    description: Power down input, kept deasserted.

  mode-gpios:
    items:
      - description: MS1 microstep selection input
      - description: MS2 microstep selection input

required:
  - compatible
  - vm-supply
  - enable-gpios
  - dir-gpios
  - step-gpios

additionalProperties: false

examples:
  - |
    #include <dt-bindings/gpio/gpio.h>

    stepper-motor {
        compatible = "relmon,ms35774";
        vm-supply = <&motor_vm>;
        enable-gpios = <&pio 166 GPIO_ACTIVE_LOW>;
        dir-gpios = <&pio 167 GPIO_ACTIVE_HIGH>;
        step-gpios = <&pio 168 GPIO_ACTIVE_HIGH>;
        powerdown-gpios = <&pio 164 GPIO_ACTIVE_HIGH>;
        mode-gpios = <&pio 171 GPIO_ACTIVE_HIGH>,
                     <&pio 170 GPIO_ACTIVE_HIGH>;
    };
```

## Documentation/devicetree/bindings/sound/mediatek,mt6765-audio.yaml
```yaml
# SPDX-License-Identifier: (GPL-2.0-only OR BSD-2-Clause)
%YAML 1.2
---
$id: http://devicetree.org/schemas/sound/mediatek,mt6765-audio.yaml#
$schema: http://devicetree.org/meta-schemas/core.yaml#

title: MediaTek MT6765 AFE PCM controller

maintainers:
  - itskenny0 <0@kenny.cat>

description:
  Audio front end of the MT6765 (Helio P35). It is a child of the audsys
  syscon and shares its register space.

properties:
  compatible:
    const: mediatek,mt6765-audio

  interrupts:
    maxItems: 1

  resets:
    maxItems: 1

  reset-names:
    const: audiosys

  memory-region:
    maxItems: 1

  clocks:
    items:
      - description: AFE clock
      - description: ADDA DAC clock
      - description: ADDA DAC pre-distortion clock
      - description: ADDA ADC clock
      - description: Audio infra sys clock
      - description: Audio infra 26M clock
      - description: Mux for audio clock
      - description: Mux for audio internal bus clock
      - description: Main PLL divider by 4, audio internal bus parent
      - description: 26M oscillator

  clock-names:
    items:
      - const: aud_afe_clk
      - const: aud_dac_clk
      - const: aud_dac_predis_clk
      - const: aud_adc_clk
      - const: aud_infra_clk
      - const: mtkaif_26m_clk
      - const: top_mux_audio
      - const: top_mux_aud_intbus
      - const: top_syspll1_d4
      - const: top_clk26m_clk

required:
  - compatible
  - interrupts
  - clocks
  - clock-names

additionalProperties: false

examples:
  - |
    #include <dt-bindings/clock/mt6765-clk.h>
    #include <dt-bindings/interrupt-controller/arm-gic.h>
    #include <dt-bindings/interrupt-controller/irq.h>

    audio-controller {
        compatible = "mediatek,mt6765-audio";
        interrupts = <GIC_SPI 153 IRQ_TYPE_LEVEL_LOW>;
        clocks = <&audsys CLK_AUDIO_AFE>,
                 <&audsys CLK_AUDIO_DAC>,
                 <&audsys CLK_AUDIO_DAC_PREDIS>,
                 <&audsys CLK_AUDIO_ADC>,
                 <&infracfg CLK_IFR_AUDIO>,
                 <&infracfg CLK_IFR_AUDIO_26M_BCLK>,
                 <&topckgen CLK_TOP_AUDIO_SEL>,
                 <&topckgen CLK_TOP_AUD_INTBUS_SEL>,
                 <&topckgen CLK_TOP_SYSPLL1_D4>,
                 <&clk26m>;
        clock-names = "aud_afe_clk",
                      "aud_dac_clk",
                      "aud_dac_predis_clk",
                      "aud_adc_clk",
                      "aud_infra_clk",
                      "mtkaif_26m_clk",
                      "top_mux_audio",
                      "top_mux_aud_intbus",
                      "top_syspll1_d4",
                      "top_clk26m_clk";
    };
```

## Documentation/devicetree/bindings/sound/mediatek,mt6765-mt6357-sound.yaml
```yaml
# SPDX-License-Identifier: (GPL-2.0-only OR BSD-2-Clause)
%YAML 1.2
---
$id: http://devicetree.org/schemas/sound/mediatek,mt6765-mt6357-sound.yaml#
$schema: http://devicetree.org/meta-schemas/core.yaml#

title: MediaTek MT6765 sound card with MT6357 codec

maintainers:
  - itskenny0 <0@kenny.cat>

description:
  The MT6765 AFE ADDA interface drives the MT6357 PMIC codec over MTKAIF.
  An analog speaker amplifier may follow the MT6357 line output.

allOf:
  - $ref: sound-card-common.yaml#

properties:
  compatible:
    const: mediatek,mt6765-mt6357-sound

  mediatek,platform:
    $ref: /schemas/types.yaml#/definitions/phandle
    description: The MT6765 AFE.

  mediatek,speaker-amplifier:
    $ref: /schemas/types.yaml#/definitions/phandle
    description:
      Speaker amplifier component fed from the MT6357 line output.

  pinctrl-names:
    items:
      - const: aud_mosi_off
      - const: aud_mosi_on
      - const: aud_miso_off
      - const: aud_miso_on

required:
  - compatible
  - mediatek,platform

unevaluatedProperties: false

examples:
  - |
    sound {
        compatible = "mediatek,mt6765-mt6357-sound";
        model = "rabbit-r1";
        mediatek,platform = <&afe>;
        mediatek,speaker-amplifier = <&speaker_amp>;
        pinctrl-names = "aud_mosi_off", "aud_mosi_on",
                        "aud_miso_off", "aud_miso_on";
        pinctrl-0 = <&aud_mosi_off_pins>;
        pinctrl-1 = <&aud_mosi_on_pins>;
        pinctrl-2 = <&aud_miso_off_pins>;
        pinctrl-3 = <&aud_miso_on_pins>;
    };
```

## drivers/gpu/img-rogue-mtk/Kconfig
```kconfig
# SPDX-License-Identifier: GPL-2.0-only
config DRM_PVR_MTK_DDK
	tristate "MediaTek PowerVR Rogue DDK 1.13 (pvrsrvkm) for MT6765"
	depends on DRM && ARM64 && OF
	depends on COMMON_CLK && PM
	select DMA_SHARED_BUFFER
	select SYNC_FILE
	select FW_LOADER
	help
	  Port of the Imagination PowerVR Rogue services kernel driver
	  shipped by MediaTek in the stock Rabbit R1 kernel
	  (DDK 1.13, m1.13ED5776728, GE8320 BVNC 22.87.104.18).

	  The userspace bridge ABI (ioctls, bridge tables and the "pvr"
	  DRM driver) is kept identical to the stock DDK so that the
	  stock Android userspace GPU blobs can talk to it. This is not
	  the upstream "powervr" DRM driver and does not share its UAPI.

	  The module is called pvrsrvkm and loads the firmware files
	  rgx.fw and rgx.sh.
```

## drivers/staging/mtk-ccci/Kconfig
```kconfig
# SPDX-License-Identifier: GPL-2.0
config MTK_CCCI_R1_MD_PROBE
	tristate "Rabbit r1 MT6765 modem bring-up probe"
	depends on ARCH_MEDIATEK || COMPILE_TEST
	depends on OF && PM && MMU
	select MFD_SYSCON
	help
	  Bring-up tool for the integrated MD1 modem of the MT6765. It
	  decodes the modem handoff LK leaves in the device tree and, when
	  loaded with stage=1 or stage=2, powers the modem up with the
	  vendor sequence, releases it and waits for its first handshake,
	  logging every step. It never loads on its own and does nothing
	  beyond reading state unless asked to.

	  To compile this driver as a module, choose M here: the module
	  will be called r1-md-probe. If unsure, say N.

config MTK_CCCI
	tristate "MediaTek MT6765 CCCI modem interface (vendor port)"
	depends on ARCH_MEDIATEK || COMPILE_TEST
	depends on OF && PM && MMU && NET && INET
	select MFD_SYSCON
	help
	  Port of the CCCI driver stack of the stock MT6765 Linux 4.19
	  vendor kernel: the CCCI core and state machine, the CCIF control
	  and CLDMA data host interfaces of the gen93 modem, the character
	  device ports (/dev/ccci_*, /dev/ttyC*) used by the MediaTek
	  modem userspace and the ccmni network devices. The userspace ABI
	  is kept identical to the stock kernel so that the stock Android
	  vendor blobs (ccci_mdinit, ccci_fsd, rild) can use it.

	  The modem image is loaded and protected by LK; this driver only
	  powers, boots and talks to it. It binds the same device tree node
	  as the bring-up probe, so load one or the other. Nothing loads it
	  automatically.

	  To compile this driver as a module, choose M here: the module
	  will be called mtk-ccci. If unsure, say N.

config MTK_ECCCI_C2K
	bool "CDMA2000 (C2K) support in the MT6765 modem"
	depends on MTK_CCCI
	default y
	help
	  The stock MT6765 modem image is built with C2K; this keeps the
	  C2K ports and modem type handling of the stock kernel.
```

## drivers/staging/mtk-connectivity/Kconfig
```kconfig
# SPDX-License-Identifier: GPL-2.0
menuconfig MTK_CONNECTIVITY
	bool "MediaTek MT6765 CONSYS connectivity (WMT/STP, gen4m, BT, GPS)"
	depends on ARCH_MEDIATEK && ARM64 && OF
	help
	  Port of the MediaTek out-of-tree connectivity stack shipped with
	  the stock Rabbit R1 (MT6765, CONNAC 1.x "soc1_0" CONSYS): the
	  BTIF UART-like link, the WMT/STP/PSM core that powers CONSYS and
	  downloads its ROM patches, the gen4m WLAN driver over the AXI
	  WFDMA, a Bluetooth HCI driver on top of the STP BT channel and
	  the GPS character devices used by the stock mnld.

	  If unsure, say N.

if MTK_CONNECTIVITY

config MTK_CONN_BTIF
	tristate "MediaTek BTIF (Bluetooth interface) driver"
	depends on COMMON_CLK && HAS_DMA
	help
	  The BTIF block carries MediaTek STP between the AP and the CONSYS
	  MCU, using two AP_DMA channels. Required by the WMT core.

	  The module is called mtk_btif_drv.

config MTK_CONN_WMT
	tristate "MediaTek WMT/STP CONSYS core"
	depends on MTK_CONN_BTIF
	depends on MFD_MT6397 && REGULATOR && PM
	depends on THERMAL_OF || !THERMAL_OF
	select FW_LOADER
	help
	  Powers the MT6765 CONSYS on through the CONN power domain and the
	  MT6357 VCN18/VCN28/VCN33 regulators, loads the soc1_0 ROM patches
	  into the consys-reserve-memory carveout and runs the WMT handshake
	  over BTIF/STP. Firmware (soc1_0_*.bin, WMT_SOC.cfg) is requested
	  at runtime, so build this as a module and load it after /vendor
	  is mounted.

	  The module is called wmt_drv.

config MTK_CONN_WMT_AUTOLAUNCH
	bool "Do the wmt_launcher patch lookup in the kernel"
	depends on MTK_CONN_WMT
	default y
	help
	  The stock Android build runs the proprietary wmt_loader and
	  wmt_launcher daemons, which select the BTIF STP mode and answer
	  the kernel's "srh_patch"/"srh_rom_patch" requests. With this
	  option the WMT core does both itself from the firmware headers,
	  so no MediaTek userspace is needed. The daemons' ioctls still
	  work.

config MTK_CONN_WLAN_CHRDEV
	tristate "MediaTek WMT Wi-Fi power control character device"
	depends on MTK_CONN_WMT
	help
	  Provides /dev/wmtWifi, which turns the CONSYS Wi-Fi function on
	  and off. Required by the gen4m driver.

	  The module is called wmt_chrdev_wifi.

config MTK_CONN_WLAN_GEN4M
	tristate "MediaTek gen4m Wi-Fi driver (CONNAC soc1_0, AXI)"
	depends on MTK_CONN_WLAN_CHRDEV && CFG80211
	help
	  The MediaTek gen4m cfg80211 driver for the MT6765 CONSYS Wi-Fi
	  (WIFI_RAM_CODE_soc1_0_1_1.bin).

	  The module is called wlan_drv_gen4m.

config MTK_CONN_BT
	tristate "Bluetooth HCI driver over the WMT STP BT channel"
	depends on MTK_CONN_WMT && BT
	help
	  Registers an HCI device that carries H:4 packets over the STP
	  Bluetooth channel of the MT6765 CONSYS, so that the kernel
	  Bluetooth stack (and the HCI user channel used by the AOSP
	  Bluetooth HAL) can drive the controller.

	  The module is called btmtk_wmt.

config MTK_CONN_GPS
	tristate "MediaTek GPS character devices over the WMT STP GPS channel"
	depends on MTK_CONN_WMT
	help
	  Provides /dev/stpgps, which powers the GPS function of the MT6765
	  CONSYS through WMT and carries its data over the STP GPS channel,
	  and /dev/gps_emi. The proprietary mnld daemon of the stock
	  Android build drives the receiver through them.

	  The module is called gps_drv.

endif
```
